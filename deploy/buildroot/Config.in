## deploy/buildroot/package/rtpmidid/Config.in
```kconfig
config BR2_PACKAGE_RTPMIDID
	bool "rtpmidid"
	depends on BR2_USE_MMU
	depends on BR2_INSTALL_LIBSTDCPP
	depends on BR2_PACKAGE_SYSTEMD
	select BR2_PACKAGE_LIBCURL
	select BR2_PACKAGE_LIBPCAP
	select BR2_PACKAGE_ZLIB
	select BR2_PACKAGE_ALSA_LIB
	select BR2_PACKAGE_ALSA_LIB_SEQ
	select BR2_PACKAGE_ALSA_LIB_RAWMIDI
	select BR2_PACKAGE_AVAHI
	select BR2_PACKAGE_AVAHI_DAEMON
	select BR2_PACKAGE_AVAHI_LIBAVAHI_CLIENT
	select BR2_PACKAGE_FMT
	help
          Real Time Protocol Musical Instrument Digital Interface Daemon
	  See the following website for more information:
	  https://github.com/davidmoreno/rtpmidid

comment "RTP Midi is a C++17 application, please enable C++ under Toolchain"
	depends on !BR2_INSTALL_LIBSTDCPP

comment "RTP Midi requires systemd for avahi-client support (DBus)"
	depends on !BR2_PACKAGE_SYSTEMD
```
